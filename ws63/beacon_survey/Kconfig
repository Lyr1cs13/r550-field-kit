## ws63/beacon_survey/Kconfig
```kconfig
config SAMPLE_SUPPORT_BEACON_SURVEY_TX
    bool "R550 fixed RSSI beacon (no connection)"

config SAMPLE_SUPPORT_BEACON_SURVEY_RX
    bool "R550 mobile RSSI broadcast receiver (no connection)"
    depends on AT_SUPPORT_PLT

config SAMPLE_SUPPORT_FAS_VEHICLE_A
    bool "R550 FAS vehicle A transmitter (UART-controlled)"
    depends on AT_SUPPORT_PLT

config SAMPLE_SUPPORT_FAS_VEHICLE_B
    bool "R550 FAS vehicle B transmitter (UART-controlled)"
    depends on AT_SUPPORT_PLT
```

## ws63/sdk_integration/Kconfig.fragment
```kconfig
# Inside the existing SLE Sample choice:
osource "application/samples/bt/sle/beacon_survey/Kconfig"

# Outside the choice:
config SUPPORT_SLE_PERIPHERAL
    bool
    default y if SAMPLE_SUPPORT_BEACON_SURVEY_TX || SAMPLE_SUPPORT_FAS_VEHICLE_A || SAMPLE_SUPPORT_FAS_VEHICLE_B
config SUPPORT_SLE_CENTRAL
    bool
    default y if SAMPLE_SUPPORT_BEACON_SURVEY_RX
```
